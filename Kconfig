## Kconfig
```kconfig
config R8723BS
	tristate "Realtek RTL8723B SDIO or SPI WiFi"
	---help---
	  Help message of RTL8723BS

config WLAN_SDIO
	bool "Enable SDIO interface for Realtek"
	depends on RTL8723BS
	default n
	---help---
	  Use memory preallocated in platform
```
